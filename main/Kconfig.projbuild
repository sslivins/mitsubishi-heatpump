## main/Kconfig.projbuild
```kconfig
menu "Mitsubishi Heat Pump Controller"

    menu "WiFi"
        config WIFI_SSID
            string "WiFi SSID (fallback)"
            default ""
            help
                Fallback SSID used only when no credentials are stored in NVS
                (i.e. the captive portal has not been used yet). Leave empty to
                always boot into provisioning mode.

        config WIFI_PASSWORD
            string "WiFi Password (fallback)"
            default ""

        config WIFI_CONNECT_TIMEOUT_S
            int "STA connect timeout (s) before falling back to provisioning"
            default 20
            range 5 120

        config MDNS_HOSTNAME
            string "mDNS hostname"
            default "mitsubishi-heatpump"
            help
                Reachable as <hostname>.local for the diagnostics web UI.
    endmenu

    menu "MQTT"
        config MQTT_BROKER_URI
            string "Broker URI"
            default "mqtt://192.168.1.10:1883"
            help
                e.g. mqtt://host:1883 or mqtts://host:8883 for TLS.

        config MQTT_USERNAME
            string "Username"
            default ""

        config MQTT_PASSWORD
            string "Password"
            default ""

        config MQTT_BASE_TOPIC
            string "Base topic"
            default "mitsubishi2mqtt"
            help
                Topics are <base>/<friendly_name>/... matching mitsubishi2MQTT.

        config MQTT_FRIENDLY_NAME
            string "Friendly name"
            default ""
            help
                MQTT node name and Home Assistant device label. Give each unit a
                distinct name (e.g. "living_room_hp"). If left blank, the
                firmware uses "heatpump-<MAC suffix>" so multiple units never
                collide on topics or HA entities out of the box.
    endmenu

    menu "CN105 (Mitsubishi serial)"
        config CN105_UART_PORT
            int "UART port number"
            default 1
            range 0 2

        config CN105_UART_TX_PIN
            int "TX GPIO (to CN105)"
            default 1
            help
                Confirm against your Stamp-S3Bat -> CN105 harness wiring.

        config CN105_UART_RX_PIN
            int "RX GPIO (from CN105)"
            default 2
    endmenu

    menu "M5PM1 PMIC (battery / charger)"
        config PMIC_I2C_SDA_PIN
            int "I2C SDA GPIO"
            default 48
            help
                Stamp-S3Bat internal I2C: SDA=GPIO48, SCL=GPIO47 (per S015 schematic).

        config PMIC_I2C_SCL_PIN
            int "I2C SCL GPIO"
            default 47
    endmenu

endmenu
```

## sdkconfig.defaults
```kconfig
# ---------------------------------------------------------------------------
# mitsubishi-heatpump — M5Stack Stamp-S3Bat (ESP32-S3-PICO-1, 8MB flash)
# ---------------------------------------------------------------------------

# Target
CONFIG_IDF_TARGET="esp32s3"

# Flash — Stamp-S3Bat is 8MB
CONFIG_ESPTOOLPY_FLASHSIZE_8MB=y
CONFIG_ESPTOOLPY_FLASHSIZE="8MB"
CONFIG_PARTITION_TABLE_CUSTOM=y
CONFIG_PARTITION_TABLE_CUSTOM_FILENAME="partitions.csv"

# PSRAM — the -R8 die has octal PSRAM; IGNORE_NOTFOUND lets non-R parts boot.
CONFIG_SPIRAM=y
CONFIG_SPIRAM_MODE_OCT=y
CONFIG_SPIRAM_IGNORE_NOTFOUND=y

# Console on the built-in USB Serial/JTAG (no external UART bridge on the Stamp)
CONFIG_ESP_CONSOLE_USB_SERIAL_JTAG=y
CONFIG_ESP_CONSOLE_SECONDARY_NONE=y

# WiFi — leave blank here; set real creds in sdkconfig.defaults.local or via the
# captive portal. Disable power-save for low-latency MQTT command response.
CONFIG_WIFI_SSID=""
CONFIG_WIFI_PASSWORD=""
CONFIG_ESP_WIFI_STA_DISCONNECTED_PM_ENABLE=n

# OTA rollback protection — a bad OTA rolls back to the last good slot unless
# the new firmware calls esp_ota_mark_app_valid_cancel_rollback() after MQTT
# reconnects successfully.
CONFIG_BOOTLOADER_APP_ROLLBACK_ENABLE=y

# TLS cert bundle (optional MQTT-over-TLS + HTTPS OTA from GitHub)
CONFIG_MBEDTLS_CERTIFICATE_BUNDLE=y
CONFIG_MBEDTLS_CERTIFICATE_BUNDLE_DEFAULT_FULL=y

# Misc
CONFIG_FREERTOS_HZ=1000
CONFIG_COMPILER_OPTIMIZATION_SIZE=y
CONFIG_ESP_MAIN_TASK_STACK_SIZE=6144

# HTTP server — browsers send large header sets (User-Agent + sec-ch-* +
# Origin + Referer + cookies). The 512-byte default rejects the login POST
# with "Header fields are too long". 2KB gives ample headroom.
CONFIG_HTTPD_MAX_REQ_HDR_LEN=2048
```

## sdkconfig.defaults.local.example
```kconfig
# Copy this file to sdkconfig.defaults.local (gitignored) and fill in real
# values for local development. CMakeLists.txt appends it after
# sdkconfig.defaults so these win. The captive portal can override WiFi at
# runtime; this is just a convenient fallback while flashing on the bench.

CONFIG_WIFI_SSID="my-iot-ssid"
CONFIG_WIFI_PASSWORD="my-iot-password"

# MQTT broker fallback (also configurable via the web portal / NVS)
CONFIG_MQTT_BROKER_URI="mqtt://192.168.1.10:1883"
CONFIG_MQTT_USERNAME=""
CONFIG_MQTT_PASSWORD=""
CONFIG_MQTT_BASE_TOPIC="mitsubishi2mqtt"
CONFIG_MQTT_FRIENDLY_NAME="living_room_hp"
```
